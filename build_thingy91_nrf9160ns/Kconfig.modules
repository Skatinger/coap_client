## build_thingy91_nrf9160ns/Kconfig.modules
```kconfig
osource "C:/Users/Alex/ncs/v1.3.0/nrf/Kconfig.nrf"

osource "C:/Users/Alex/ncs/v1.3.0/bootloader/mcuboot/zephyr/Kconfig"

osource "C:/Users/Alex/ncs/v1.3.0/nrfxlib/Kconfig.nrfxlib"
```
